#include "sofle_custom.dtsi"

&default_transform {
    col-offset = <6>;
};

&kscan0 {
    col-gpios
        = <&pro_micro 19 GPIO_ACTIVE_HIGH>  // COL0
        , <&pro_micro 18 GPIO_ACTIVE_HIGH>  // COL1
        , <&pro_micro 15 GPIO_ACTIVE_HIGH>  // COL2
        , <&pro_micro 14 GPIO_ACTIVE_HIGH>  // COL3
        , <&pro_micro 16 GPIO_ACTIVE_HIGH>  // COL4
        , <&pro_micro 10 GPIO_ACTIVE_HIGH>  // COL5
        ;

    row-gpios
        = <&pro_micro 5 (GPIO_ACTIVE_HIGH | GPIO_PULL_DOWN)>  // ROW0
        , <&pro_micro 6 (GPIO_ACTIVE_HIGH | GPIO_PULL_DOWN)>  // ROW1
        , <&pro_micro 7 (GPIO_ACTIVE_HIGH | GPIO_PULL_DOWN)>  // ROW2
        , <&pro_micro 8 (GPIO_ACTIVE_HIGH | GPIO_PULL_DOWN)>  // ROW3
        ;
};

&left_encoder {
    status = "okay";
};

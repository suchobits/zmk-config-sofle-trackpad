## boards/shields/sofle_custom/Kconfig.defconfig
```kconfig
if SHIELD_SOFLE_CUSTOM_LEFT || SHIELD_SOFLE_CUSTOM_RIGHT

config ZMK_KEYBOARD_NAME
    default "Sofle Custom"

config ZMK_SPLIT
    default y

endif

# LEFT side is PERIPHERAL
if SHIELD_SOFLE_CUSTOM_LEFT

config ZMK_SPLIT_ROLE_CENTRAL
    default n

config ZMK_USB
    default n

endif

# RIGHT side is CENTRAL because it has the trackpad
if SHIELD_SOFLE_CUSTOM_RIGHT

config ZMK_SPLIT_ROLE_CENTRAL
    default y

# Enable USB on central
config ZMK_USB
    default y

# Enable pointing device support on central (right side)
config ZMK_POINTING
    default y

# Enable I2C for trackpad
config I2C
    default y

endif

if SHIELD_SOFLE_CUSTOM_LEFT || SHIELD_SOFLE_CUSTOM_RIGHT

# Enable RGB underglow
config ZMK_RGB_UNDERGLOW
    default y

# Enable encoder support
config EC11
    default y

config EC11_TRIGGER_GLOBAL_THREAD
    default y

endif
```

## config/boards/shields/sofle_custom/Kconfig.defconfig
```kconfig
if SHIELD_SOFLE_CUSTOM_LEFT || SHIELD_SOFLE_CUSTOM_RIGHT

config ZMK_KEYBOARD_NAME
    default "Sofle Custom"

config ZMK_SPLIT
    default y

endif

# RIGHT side is CENTRAL because it has the trackpad
if SHIELD_SOFLE_CUSTOM_RIGHT

config ZMK_SPLIT_ROLE_CENTRAL
    default y

# Enable pointing device support on central (right side)
config ZMK_POINTING
    default y

# Enable I2C for trackpad
config I2C
    default y

endif

if SHIELD_SOFLE_CUSTOM_LEFT || SHIELD_SOFLE_CUSTOM_RIGHT

# Enable RGB underglow
config ZMK_RGB_UNDERGLOW
    default y

# Enable encoder support
config EC11
    default y

config EC11_TRIGGER_GLOBAL_THREAD
    default y

endif
```

## config/west.yml
```yaml
manifest:
  defaults:
    revision: v0.3
  remotes:
    - name: zmkfirmware
      url-base: https://github.com/zmkfirmware
    - name: azoteq-driver
      url-base: https://github.com/AYM1607
  projects:
    - name: zmk
      remote: zmkfirmware
      import: app/west.yml
    - name: zmk-driver-azoteq-iqs5xx
      remote: azoteq-driver
      revision: main
  self:
    path: config
```
